## nuttx/apps/bootsel/Kconfig
```kconfig
#
# For a description of the syntax of this configuration file,
# see the file kconfig-language.txt in the NuttX tools repository.
#

config NANO_APP_BOOTSEL
	tristate "bootsel command (restart into the USB bootloader)"
	default y
	depends on ARCH_CHIP_RP2040
	---help---
		"bootsel" restarts the board into the boot ROM's USB loader
		(BOOTSEL: the RPI-RP2 drive), as the FreeRTOS build's command
		of the same name: the board's nano_reset_usb_boot()
		(<arch/board/nano_reset.h>, the ROM's reset_usb_boot(0, 0)), a
		flat build lets an application call it.  No confirmation word;
		arguments are ignored.

if NANO_APP_BOOTSEL

config NANO_APP_BOOTSEL_PRIORITY
	int "bootsel task priority"
	default 104
	---help---
		The shell's priority (NANO_PRIO_SHELL in
		common/compat/priorities.h).

config NANO_APP_BOOTSEL_STACKSIZE
	int "bootsel stack size"
	default 1024
	---help---
		One line of output and the restart.

endif
```

## nuttx/apps/dmesg/Kconfig
```kconfig
#
# For a description of the syntax of this configuration file,
# see the file kconfig-language.txt in the NuttX tools repository.
#

config APP_DMESG
	tristate "dmesg command (RAM log)"
	default y
	depends on LOG_RAM
	---help---
		"dmesg" prints the RAM log (common/compat/log/log_ram.c) the way
		the Zephyr build's dmesg command does: the stored text as is, or
		"No logs." when it is empty.  Arguments are ignored.  NuttX's own
		nsh dmesg (NSH_DISABLE_DMESG) reads /dev/kmsg and is not used.

if APP_DMESG

config APP_DMESG_PRIORITY
	int "dmesg task priority"
	default 104
	---help---
		The Zephyr build runs shell commands in the shell thread, at
		K_LOWEST_APPLICATION_THREAD_PRIO (14), which is 104 here
		(common/compat/include/priorities.h, APP_PRIO_SHELL).

config APP_DMESG_STACKSIZE
	int "dmesg stack size"
	default 3072
	---help---
		CONFIG_SHELL_STACK_SIZE of the Zephyr build, which runs shell
		commands in the shell thread.  The output goes through the
		caller's stack down to the NINA's SPI transfer when the command
		runs in a Telnet session (nuttx/apps/init/rp2040_telnet.c); 1024
		overflowed there.

endif
```

## nuttx/apps/i2c/Kconfig
```kconfig
#
# For a description of the syntax of this configuration file,
# see the file kconfig-language.txt in the NuttX tools repository.
#

config APP_I2C
	tristate "i2c command (the Zephyr build's I2C shell)"
	default y
	depends on SUBCMD && I2C_DW_I2C0
	---help---
		"i2c scan|recover|read|read_byte|direct_read|write|write_byte|
		speed": the Zephyr build's I2C shell
		(common/shell/i2c_shell.c, Zephyr v4.5.0's
		drivers/i2c/i2c_shell.c with the local patch 0004) with the
		same syntax and output, on the Zephyr compatibility layer's
		I2C bus device i2c0 ("i2c@40044000", the one the LSM6DSO
		driver uses: "i2c speed" changes the speed of its transfers)
		and the Zephyr shell's command handling of
		common/shell/zshell.c.  CONFIG_I2C_TARGET is not set in the
		Zephyr build, so there is no "i2c target".

if APP_I2C

config I2C_SHELL_BUFFER_SIZE
	int "Most bytes of one read or write"
	default 64
	---help---
		The Zephyr build's CONFIG_I2C_SHELL_BUFFER_SIZE.

config APP_I2C_PRIORITY
	int "i2c task priority"
	default 104
	---help---
		The shell's priority (APP_PRIO_SHELL in
		common/compat/include/priorities.h): the Zephyr build runs shell
		commands in its shell thread.

config APP_I2C_STACKSIZE
	int "i2c stack size"
	default 3072
	---help---
		The Zephyr build runs the command on the shell thread's stack
		(CONFIG_SHELL_STACK_SIZE 3072).

endif
```

## nuttx/apps/i2c_dma/Kconfig
```kconfig
#
# For a description of the syntax of this configuration file,
# see the file kconfig-language.txt in the NuttX tools repository.
#

config I2C_DW_RP2040_DMA_SHELL
	tristate "i2c_dma command (I2C0 DMA reads)"
	default y
	depends on I2C_DW_RP2040_DMA && NANO_SUBCMD
	---help---
		"i2c_dma mode [on|off]" and "i2c_dma stats": the command of the
		Zephyr and FreeRTOS builds
		(common/shell/i2c_dma_shell.c), with the same syntax,
		help and output, on the Zephyr shell's command handling of
		common/shell/zshell.c and the board's I2C driver
		(I2C_DW_RP2040_DMA).

if I2C_DW_RP2040_DMA_SHELL

config I2C_DW_RP2040_DMA_SHELL_PRIORITY
	int "i2c_dma task priority"
	default 104
	---help---
		The shell's priority (NANO_PRIO_SHELL in
		common/compat/priorities.h): the Zephyr build runs shell
		commands in its shell thread.

config I2C_DW_RP2040_DMA_SHELL_STACKSIZE
	int "i2c_dma stack size"
	default 3072
	---help---
		The Zephyr build runs the command on the shell thread's stack
		(CONFIG_SHELL_STACK_SIZE 3072).

endif
```

## nuttx/apps/init/Kconfig
```kconfig
#
# For a description of the syntax of this configuration file,
# see the file kconfig-language.txt in the NuttX tools repository.
#

config APP_INIT
	bool "Init task: nsh on the USB CDC ACM console"
	default n
	depends on NSH_LIBRARY && NSH_CONSOLE && CDCACM && !CDCACM_CONSOLE && !NSH_USBCONSOLE
	depends on SCHED_WAITPID
	---help---
		The first task (CONFIG_INIT_ENTRYPOINT="rp2040_init_main").  It is
		linked into libapps as a plain function, not as a builtin, so it
		cannot be started from the shell.  It calls nsh_initialize() once,
		then repeatedly opens the USB console (INIT_CONSOLE), sets the
		terminal modes, makes it fd 0/1/2 and runs an nsh session on it in
		its own task until the session ends (USB disconnected), then opens
		the console again.  NuttX's own USB console front end
		(NSH_USBCONSOLE, CDCACM_CONSOLE) waits for three Enter keys before
		the first prompt and is not used.

if APP_INIT

config INIT_CONSOLE
	string "Console device"
	default "/dev/ttyACM0"
	---help---
		The CDC ACM device registered by the board (cdcacm_initialize(0)
		in rp2040_bringup.c).

config INIT_RETRY_MS
	int "Retry interval (ms)"
	default 100
	---help---
		How long to wait before trying again while the console cannot be
		opened (USB not configured: -ENOTCONN) or is disconnected, and
		after a session has ended.  Keeps a USB cable that is unplugged or
		a host that suspends the device from turning into a busy loop.

config INIT_NSH_PRIORITY
	int "nsh task priority"
	default 104
	---help---
		Priority of the nsh session task.  The Zephyr build runs its shell
		thread at the lowest application priority,
		K_LOWEST_APPLICATION_THREAD_PRIO (14), which is 104 here
		(APP_PRIO_SHELL in common/compat/include/priorities.h): below
		every other thread of the port.

config INIT_NSH_STACKSIZE
	int "nsh task stack size"
	default 3072
	---help---
		Stack of the nsh session task: nsh's own commands (ps, free, ...)
		run on it.  Builtin applications run as separate tasks with their
		own stacks.  3072 is CONFIG_SHELL_STACK_SIZE of the Zephyr build.

config INIT_TELNET
	bool "Telnet shell"
	default y
	depends on NETDEV_TELNET && NET_IPv4
	---help---
		nsh on TCP port INIT_TELNET_PORT for one client at a time,
		the Zephyr build's Telnet shell backend
		(CONFIG_SHELL_BACKEND_TELNET).  init opens the listening socket
		before the "USB console started" log line, as Zephyr does in a
		SYS_INIT before main(), and a task ("telnetd") accepts the
		clients; a second client is closed at once with "Telnet client
		already connected." in the log.  The sessions run on NuttX's
		Telnet driver (NETDEV_TELNET, TELNET_MAXLCLIENTS=1) with the same
		priority and stack as the USB session.  See rp2040_telnet.c.

config INIT_TELNET_PORT
	int "Telnet port"
	default 23
	depends on INIT_TELNET
	---help---
		CONFIG_SHELL_TELNET_PORT of the Zephyr build.

endif
```

## nuttx/apps/kv/Kconfig
```kconfig
#
# For a description of the syntax of this configuration file,
# see the file kconfig-language.txt in the NuttX tools repository.
#

config APP_KV
	tristate "kv command (key-value store)"
	default y
	depends on KV_STORE && SUBCMD
	---help---
		"kv set|sethex|get|delete|wipe": the Zephyr build's kv command
		(common/imu/kv_store.c, shared with the Zephyr build; its
		SHELL_CMD_REGISTER() makes z_shell_main_kv()) with the same
		syntax and messages, on the key-value store of nuttx/apps/imu
		(KV_STORE).  "kv wipe confirm" (not in the Zephyr build,
		common/compat/kv_store_os.h) erases the whole key-value area.

if APP_KV

config APP_KV_PRIORITY
	int "kv task priority"
	default 104
	---help---
		The shell's priority (NANO_PRIO_SHELL in
		common/compat/priorities.h): the Zephyr build runs shell
		commands in its shell thread.

config APP_KV_STACKSIZE
	int "kv stack size"
	default 3072
	---help---
		The Zephyr build runs the command on the shell thread's stack
		(CONFIG_SHELL_STACK_SIZE 3072).  The settings and NVS calls,
		with garbage collection, run on this stack too.

endif
```

## nuttx/apps/nina/Kconfig
```kconfig
#
# For a description of the syntax of this configuration file,
# see the file kconfig-language.txt in the NuttX tools repository.
#

config APP_NINA
	tristate "nina command (NINA-W102 module)"
	default y
	depends on NINA && SUBCMD
	---help---
		"nina version": the Zephyr build's nina command
		(src/main.c, cmd_nina_version()) with the same output, on
		nina_wifi_fw_version() of the NINA driver (NINA).  With the
		board's NINA_PASSTHROUGH, also "nina passthrough confirm"
		(the Zephyr and FreeRTOS builds'): a restart into the NINA
		passthrough mode for esptool.

if APP_NINA

config APP_NINA_PRIORITY
	int "nina task priority"
	default 104
	---help---
		The shell's priority (APP_PRIO_SHELL in
		common/compat/priorities.h): the Zephyr build runs shell
		commands in its shell thread, and nina_proto_request() runs the SPI
		transfer at the caller's priority.

config APP_NINA_STACKSIZE
	int "nina stack size"
	default 3072
	---help---
		The Zephyr build runs the command on the shell thread's stack
		(CONFIG_SHELL_STACK_SIZE 3072).

endif
```

## nuttx/apps/ntp/Kconfig
```kconfig
#
# For a description of the syntax of this configuration file,
# see the file kconfig-language.txt in the NuttX tools repository.
#

config NANO_APP_NTP
	tristate "ntp command (ntp status)"
	default y
	depends on NANO_TIME_SYNC && NANO_SUBCMD
	---help---
		"ntp status": the Zephyr build's ntp command (cmd_ntp_status()
		of common/imu/time_sync.c, shared with the Zephyr build) with the
		same syntax and output.  The handler and its command set stay in
		that file, as in the Zephyr build (its SHELL_CMD_REGISTER()
		makes z_shell_main_ntp()); this is the builtin command that runs
		them.

if NANO_APP_NTP

config NANO_APP_NTP_PRIORITY
	int "ntp task priority"
	default 104
	---help---
		The shell's priority (NANO_PRIO_SHELL in
		common/compat/priorities.h): the Zephyr build runs shell
		commands in its shell thread.

config NANO_APP_NTP_STACKSIZE
	int "ntp stack size"
	default 3072
	---help---
		The Zephyr build runs the command on the shell thread's stack
		(CONFIG_SHELL_STACK_SIZE 3072).  Over Telnet the output goes to
		the NINA on this stack.

endif
```

## nuttx/apps/sensor/Kconfig
```kconfig
#
# For a description of the syntax of this configuration file,
# see the file kconfig-language.txt in the NuttX tools repository.
#

config APP_SENSOR
	tristate "sensor command (the Zephyr build's sensor shell)"
	default y
	depends on SUBCMD && LSM6DSO_STREAM
	---help---
		"sensor get|attr_set|attr_get|stream|trig": the Zephyr build's
		sensor shell (common/shell/sensor_shell.c,
		Zephyr v4.5.0's drivers/sensor/sensor_shell.c with the
		LSM6DSO's FIFO attributes, and sensor_shell_stream.c)
		with the same syntax and output, on the Zephyr compatibility
		layer and the Zephyr shell's command handling of
		common/shell/zshell.c.  Also the thread
		sensor_shell_tid (Zephyr priority 0, NuttX 118,
		CONFIG_SENSOR_SHELL_THREAD_STACK_SIZE 3072), which the init task
		starts at boot and which prints the results of "sensor get" and
		"sensor stream" on the terminal of the session that asked for
		them.  CONFIG_SENSOR_INFO is not set in the Zephyr build, so
		there is no "sensor info".

if APP_SENSOR

config APP_SENSOR_PRIORITY
	int "sensor task priority"
	default 104
	---help---
		The shell's priority (APP_PRIO_SHELL in
		common/compat/include/priorities.h): the Zephyr build runs shell
		commands in its shell thread.

config APP_SENSOR_STACKSIZE
	int "sensor stack size"
	default 3072
	---help---
		The Zephyr build runs the command on the shell thread's stack
		(CONFIG_SHELL_STACK_SIZE 3072).

endif
```

## nuttx/apps/subcmd/Kconfig
```kconfig
#
# For a description of the syntax of this configuration file,
# see the file kconfig-language.txt in the NuttX tools repository.
#

config SUBCMD
	bool "Subcommand dispatch with the Zephyr shell's output"
	default y
	---help---
		common/shell/subcmd.c: subcmd_main(), the subcommand sets, help, "wrong
		parameter count" and wildcard rules of the Zephyr shell
		(SHELL_CMD(), SHELL_CMD_ARG(), SHELL_CMD_REGISTER()), shared by
		the port's commands (kv, nina, ...); and common/shell/zshell.c:
		z_shell_cmd_main(), the same for the commands written with the
		Zephyr shell macros of the compatibility layer's
		<zephyr/shell/shell.h> (static and dynamic sets, SHELL_HELP()),
		with the NuttX shell backends (zshell_os_impl.h here) that keep
		a session's terminal for output after the command has returned
		(sensor).  Built into the application library.
```
