## nuttx/boards/arduino-nano-rp2040-connect/Kconfig
```kconfig
#
# For a description of the syntax of this configuration file,
# see the file kconfig-language.txt in the NuttX tools repository.
#
# Board-specific options of arduino-nano-rp2040-connect.  NuttX sources
# this file inside "if ARCH_BOARD_CUSTOM" through a copy,
# nuttx/nuttx/boards/dummy/Kconfig, made once at configure time;
# nuttx/script/build.sh configures again when this file changes.
#

config RP2040_TICKLESS
	bool "System timer on the RP2040 TIMER (ALARM0)"
	default y
	depends on ARCH_CHIP_RP2040 && !SMP
	select ONESHOT
	select ONESHOT_COUNT
	select ALARM_ARCH
	---help---
		Drive the OS clock from ALARM0 of the RP2040 TIMER (64-bit, 1 MHz,
		from the crystal) through the oneshot/alarm interface
		(src/rp2040_oneshot.c, src/rp2040_timerisr_alarm.c and
		drivers/timers/arch_alarm.c) instead of the periodic SysTick of
		arch/arm/src/rp2040/rp2040_timerisr.c.  ALARM_ARCH selects
		ARCH_HAVE_TICKLESS, so SCHED_TICKLESS can be set (the imu
		defconfig sets it, with USEC_PER_TICK 100: the 100 us tickless
		kernel of the Zephyr build).  rp2040_timerisr.c is left out of the
		build by nuttx/patches/nuttx/0004 when ALARM_ARCH is set.
		ONESHOT_COUNT has no prompt and can only be selected.
		src/rp2040_oneshot.c also replaces the weak up_timer_gettick(),
		up_timer_gettime(), up_alarm_tick_start(), up_alarm_cancel(),
		up_udelay() and up_ndelay() of arch_alarm.c with versions that
		read the TIMER directly and convert with src/rp2040_timeconv.h
		(1 MHz counts, 100 us ticks, no 64-bit division), so it needs
		USEC_PER_TICK to be 100.  ONESHOT_FAST_DIVISION is not selected:
		it only changes the generic conversions, which these replace.

config RP2040_PERF
	bool "Perf counter on the RP2040 TIMER (up_perf_*)"
	default y
	depends on ARCH_CHIP_RP2040
	select ARCH_HAVE_PERF_EVENTS
	---help---
		src/rp2040_perf.c: up_perf_gettime() returns the TIMER count
		(nano_mono_us(), 1 MHz, 64 bits) and up_perf_getfreq() 1000000.
		The Cortex-M0+ has no cycle counter.  Used by the critical
		section monitor (SCHED_CRITMONITOR, SCHED_CPULOAD_CRITMONITOR) to
		account each task's CPU time at every context switch: the CPU
		column of ps, /proc/cpuload, /proc/<pid>/loadavg and the total
		run time in /proc/<pid>/critmon.  Without it,
		drivers/timers/arch_alarm.c supplies a slower counter in
		nanoseconds through the oneshot.

config RP2040_PICO_DIVIDER
	bool "Integer division on the RP2040 SIO divider"
	default y
	depends on ARCH_CHIP_RP2040
	select RP2040_HW_DIVIDER
	---help---
		__aeabi_idiv(), __aeabi_idivmod(), __aeabi_uidiv(),
		__aeabi_uidivmod(), __aeabi_ldivmod() and __aeabi_uldivmod()
		(every integer division the compiler emits) run on the SIO
		hardware divider instead of libgcc's shift-and-subtract loops:
		the Pico SDK's pico_divider (divider_hardware.S, built from
		nuttx/pico-sdk with the minimal headers of src/pico_sdk),
		linked with ld --wrap (scripts/Make.defs).  The routines save
		and restore the divider around a division that interrupts
		another one (PICO_DIVIDER_DISABLE_INTERRUPTS 0), and
		RP2040_HW_DIVIDER (nuttx/patches/nuttx/0009) moves the divider
		with the task at every context switch.  A division by zero
		gives the SDK's results, as in the Zephyr and FreeRTOS builds:
		for 32 bits a saturated quotient (0xffffffff, 0x7fffffff or
		0x80000000; 0 for 0 / 0) and a remainder of 0 (libgcc's gave a
		quotient of 0 and the dividend); for 64 bits the same as
		libgcc's (saturated quotient, remainder 0).  The routines use
		only the SIO and the stack, so they work from the
		start of __start(), in interrupt handlers and in the fatal error
		handling.  nuttx/script/build.sh checks that no libgcc integer
		division is left in the image.

config RP2040_STACK_SENTINEL
	bool "Stack sentinel (check the lowest stack word)"
	default y
	depends on STACK_COLORATION && !SMP && ARCH_ARMV6M
	select SCHED_INSTRUMENTATION
	select SCHED_INSTRUMENTATION_SWITCH
	select SCHED_INSTRUMENTATION_IRQHANDLER
	---help---
		Check that the lowest word of a task's stack still holds the
		coloration value when the task is switched out and at the end of
		every interrupt handler (for the interrupted task, whose stack
		holds the frame the hardware saved, and with ARCH_INTERRUPTSTACK=0
		the handler's own use too), and halt (PANIC) if not: the counterpart of
		the Zephyr build's CONFIG_STACK_SENTINEL (src/rp2040_stackcheck.c).
		Implemented in the scheduler's instrumentation hooks
		sched_note_suspend() and sched_note_irqhandler(), which need
		SCHED_INSTRUMENTATION, SCHED_INSTRUMENTATION_SWITCH and
		SCHED_INSTRUMENTATION_IRQHANDLER but no note driver.

config RP2040_FLASH_KV
	bool "Key-value area in the last 8 KiB of the flash"
	default y
	depends on ARCH_CHIP_RP2040 && !SMP
	---help---
		src/nano_flash_kv.c: reads, 256-byte page programs and 4 KiB
		sector erases of flash offsets 0xffe000-0xffffff
		(BOARD_KV_OFFSET, BOARD_KV_SIZE in include/board.h; __kv_start,
		__kv_end in scripts/arduino-nano-rp2040-connect-flash.ld), the
		place of the Zephyr build's storage_partition: the OS boundary of
		common/compat/nano_flash_kv.h, under the flash device of
		common/compat/zephyr_flash_kv.c, on which the copies of Zephyr's
		NVS and settings keep the key-value store in the Zephyr build's
		format (KV_STORE).  Every erase and program is checked to
		lie inside that area.  Nothing is erased at boot: an area that
		holds neither Zephyr's NVS nor only erased bytes is reported and
		left alone until "kv wipe confirm".
```

## nuttx/drivers/i2c_dw/Kconfig
```kconfig
#
# For a description of the syntax of this configuration file,
# see the file kconfig-language.txt in the NuttX tools repository.
#
# The I2C driver of the RP2040's two controllers: the core
# common/drivers/i2c_dw/i2c_dw.c with its NuttX binding
# common/drivers/i2c_dw/port/nuttx, built by ./Make.defs.
#

config I2C_DW_I2C0
	bool "I2C0 controller (LSM6DSOX, ATECC608A)"
	default y
	depends on ARCH_CHIP_RP2040 && I2C && !RP2040_I2C
	---help---
		I2C0 on GPIO12 (SDA) and GPIO13 (SCL), a port of the controller
		path of the Zephyr build's DesignWare driver (Zephyr's
		drivers/i2c/i2c_dw.c with the local patch
		zephyr/manifest/zephyr/patches/zephyr/
		0003-i2c-dw-rp2040-fifo-and-dma.patch): interrupt
		driven, RX in batches of 4, 1 s transfer timeout with an abort,
		the Zephyr SCL counts (100 kHz, 400 kHz, 1 MHz).  The core is
		common/drivers/i2c_dw/i2c_dw.c, its NuttX binding
		i2c_dw_instance.h and i2c_dw_os_impl.h of
		common/drivers/i2c_dw/port/nuttx.  It replaces
		NuttX's arch/arm/src/rp2040/rp2040_i2c.c, which must stay off
		(RP2040_I2C), and sets up the pins itself.  Registered as
		/dev/i2c0 when I2C_DRIVER is set (the i2c tool uses it).

config I2C_DW_I2C1
	bool "I2C1 controller (nothing connected on the board)"
	default n
	depends on ARCH_CHIP_RP2040 && I2C && !RP2040_I2C
	---help---
		I2C1 on GPIO18 (SDA, Arduino D6) and GPIO19 (SCL, D7)
		(BOARD_I2C1_SDA_GPIO, BOARD_I2C1_SCL_GPIO in include/board.h),
		with the internal pull-ups: the same core as I2C_DW_I2C0
		(common/drivers/i2c_dw/i2c_dw.c, its second instance), always on
		the interrupts (the DMA reads are I2C0's).  Brought up after
		I2C0 by rp2040_bringup(); a failure does not stop the boot.
		Registered as /dev/i2c1 when I2C_DRIVER is set (bus 1 of the i2c
		tool needs I2CTOOL_MAXBUS 1 or more).  Built and host-tested;
		not yet used with a device on the board.

config I2C_DW_RP2040_DMA
	bool "DMA reads on I2C0"
	default y
	depends on I2C_DW_I2C0 && RP2040_DMAC
	---help---
		The Zephyr build's CONFIG_I2C_DW_RP2040_DMA (the same symbol,
		on there): a read
		of 32 to 3584 bytes that is the last message of a transfer (so
		it ends with STOP) runs on two DMA channels, one writing the
		command words to IC_DATA_CMD and one reading the data; other
		transfers, and reads when no DMA channel can be had, run on the
		interrupts.  The "i2c_dma" command (nuttx/apps/i2c_dma) switches
		it and shows its counters.
		The channels come from NuttX's own DMA driver
		(arch/arm/src/rp2040/rp2040_dmac.c, RP2040_DMAC), through
		i2c_dw_dma_os_rp2040.c of common/drivers/i2c_dw/port/nuttx:
		two channels taken at start-up with
		rp2040_dmachannel_trywait() (nuttx/patches/nuttx/0011: it does
		not wait) and kept for the reads, so that a read never waits
		for a channel; without two free channels, I2C0 reads on the
		interrupts.  Other code may use the driver's other channels as
		usual: with RP2040_SPI_DMA, the SPI driver takes two more for
		SPI1 at the NINA's first request (nuttx/patches/nuttx/0013).
```

## nuttx/drivers/lsm6dso/Kconfig
```kconfig
#
# For a description of the syntax of this configuration file,
# see the file kconfig-language.txt in the NuttX tools repository.
#

config LSM6DSO_LOCAL
	bool "LSM6DSOX IMU driver (the shared LSM6DSO driver)"
	default y
	depends on I2C_DW_I2C0
	---help---
		common/drivers/lsm6dso: the driver's core (lsm6dso.c,
		lsm6dso_cal.c, lsm6dso_fifo.c) and the Zephyr build's binding
		(port/zephyr/lsm6dso_sensor.c: the device and the sensor
		API), with the device of port/nuttx/lsm6dso_instance.h, on
		ST's lsm6dso_reg.c (nuttx/stmemsc, fetched by
		script/setup.sh) and the port's small Zephyr compatibility
		layer (compat/: struct device, the sensor API, the I2C calls,
		the kernel calls of the core's boundary).  The board
		initializes the device in its bring-up, after I2C0 and before
		the key-value store, as the Zephyr build does before main()
		(src/rp2040_lsm6dso.c).  The FIFO stream (INT1, RTIO) is
		LSM6DSO_STREAM.  The Zephyr build's option of the same name
		(common/drivers/lsm6dso/port/zephyr/Kconfig), which replaces
		Zephyr's own driver (LSM6DSO there).

config LSM6DSO_STREAM
	bool
	default y
	depends on LSM6DSO_LOCAL
	---help---
		The FIFO stream of the LSM6DSO driver: the core's stream
		(lsm6dso_stream.c) and the Zephyr build's
		CONFIG_SENSOR_ASYNC_API part of its binding
		(port/zephyr/lsm6dso_rtio_stream.c, lsm6dso_rtio.c,
		lsm6dso_decoder.c, lsm6dso_os.c), on the compatibility
		layer's RTIO, work queues and gpio0 (compat/Make.defs).  Always on
		with LSM6DSO_LOCAL: as in Zephyr, lsm6dso_sensor.c does not
		build without it.  The board starts the layer's threads
		(zephyr_compat_initialize()) before the LSM6DSOX and builds
		common/compat/port/nuttx/rp2040_gpio_os.c for the INT1
		interrupt.
```

## nuttx/drivers/nina/Kconfig
```kconfig
#
# For a description of the syntax of this configuration file,
# see the file kconfig-language.txt in the NuttX tools repository.
#

config NINA
	bool "NINA-W102 SPI link (nina_proto_request())"
	default y
	depends on RP2040_SPI1 && !RP2040_SPI_DMA
	depends on LSM6DSO_STREAM
	---help---
		common/drivers/nina/internal/nina_proto.c: nina_proto_request() and nina_proto_ip_config(),
		shared with the Zephyr build (the WiFiNINA SPI protocol of the
		module's Arduino firmware), with the same framing, timeouts,
		error values and lazy initialization (the module is reset on
		the first request).  The board provides SPI1
		and the module's lines (nina_bus_rp2040.c).  SPI1 is polled, as in
		the Zephyr build (CONFIG_SPI_PL022_INTERRUPT and _DMA off), so
		RP2040_SPI_DMA must be off.  The waits for the module's READY
		line (GPIO10) sleep on its edge interrupt
		(common/drivers/nina/port/nuttx/nina_os.c),
		through the compatibility layer's gpio0 and the board's
		src/nano_gpio.c, which are built with LSM6DSO_STREAM.

if NINA

config NINA_SPI_FREQUENCY
	int "NINA SPI frequency in Hz"
	default 8000000
	range 1000000 10000000
	---help---
		The requested SPI clock, the same option as the Zephyr
		build's (default 8000000).  The PL022 divides
		clk_peri (125 MHz) by an even number: 8 MHz gives 7.8125 MHz in
		both builds.

config NINA_USRSOCK
	bool "NINA sockets (usrsock)"
	default y
	depends on NET_USRSOCK_CUSTOM
	---help---
		common/drivers/nina/nina_sock.c, and nina_usrsock.c and
		nina_poller.c of common/drivers/nina/port/nuttx: the socket offload
		of the Zephyr build (common/drivers/nina/port/zephyr/nina_socket.c) as
		NuttX's usrsock (usrsock_request() in the kernel, handled in the
		calling thread), with the same socket table (10 sockets),
		commands, timeouts and errno names.  The thread "nina_event"
		polls the module's sockets and turns their state into usrsock
		events, as the Zephyr build's connect() and poll() poll in
		their callers.

config NINA_TCP_MAX_IO
	int "Maximum bytes per NINA TCP send"
	default 3584
	range 1 3584
	depends on NINA_USRSOCK
	---help---
		The same option as the Zephyr build's.  Bounds each TCP send
		to leave room for framing in the NINA SPI command buffer.  A RAW
		batch of up to 2448 bytes plus its MQTT header is sent in one
		command with the default.

config NINA_SEND_RETRY_MS
	int "Delay before retrying a full NINA TCP send buffer"
	default 1
	range 1 1000
	depends on NINA_USRSOCK
	---help---
		The same option as the Zephyr build's.  A TCP send that
		waits and finds no room in the module is tried again after this
		delay (the event thread reports SENDTO_READY and usrsock repeats
		the request in the caller's thread), until NINA_SEND_WAIT_MS.

config NINA_NET
	bool "NINA Wi-Fi network device wlan0 (ifconfig, wapi)"
	default y
	depends on NINA_USRSOCK && LSM6DSO_STREAM
	depends on DRIVERS_IEEE80211 && NETDEV_WIRELESS_IOCTL && NET_IPv4
	---help---
		nina_wifi.c (common/drivers/nina, shared with the Zephyr build:
		scan, connect, disconnect, status and the 2-second link monitor,
		with its threads nina_scan_tid, nina_connect_tid and
		nina_monitor_tid) and its NuttX binding in
		common/drivers/nina/port/nuttx: nina_netdev.c registers the module as
		the network device wlan0 and turns wapi's wireless ioctls into
		the core's calls; nina_wifi_mgmt.c serves the applications' Zephyr
		Wi-Fi management (NET_REQUEST_WIFI_CONNECT of the stored
		networks, the connection events) on the core.  The IP address,
		netmask, gateway and MAC address are those of wlan0 (ifconfig).
		Uses the Zephyr compatibility layer's kernel objects, which are
		built with LSM6DSO_STREAM, and its net_if, net_mgmt and wifi_mgmt
		parts (the "net_mgmt" event thread).

config NINA_DNS
	bool "Name resolution with the NINA resolver (nina_dns_getaddrinfo())"
	default y
	depends on !LIBC_NETDB
	---help---
		common/drivers/nina/nina_dns.c: nina_dns_getaddrinfo() and nina_dns_freeaddrinfo()
		(<nina_dns.h>), shared with the Zephyr build, which
		resolves a name with the module's commands 0x34 and 0x35 and
		gives one IPv4 address.  The Zephyr compatibility layer's
		zsock_getaddrinfo() uses it.  Not with LIBC_NETDB (NuttX's own
		getaddrinfo()).

endif # NINA

config NINA_PASSTHROUGH
	bool "NINA passthrough mode (nina passthrough confirm)"
	default y
	depends on ARCH_CHIP_RP2040 && CDCACM && BOARD_LATE_INITIALIZE
	depends on !RP2040_UART1 && !SMP
	---help---
		The NINA driver's passthrough mode
		(common/drivers/nina/nina_passthrough.c, shared with the Zephyr
		and FreeRTOS builds; its NuttX side
		common/drivers/nina/port/nuttx/nina_passthrough_os.c, its module side
		port/nuttx/nina_passthrough_bus_rp2040.c): after "nina passthrough confirm"
		(nuttx/apps/nina) the board restarts into a mode that relays
		the USB CDC ACM port to the NINA-W102's UART (UART1 on GPIO8
		and GPIO9, the pins of SPI1's MISO and CS) with DTR and RTS on
		the module's GPIO0 and RESETN, for esptool.  The request is kept in the watchdog's scratch
		registers 0..3 over the restart; in the mode, rp2040_bringup()
		starts the USB device only and the init task runs the mode
		instead of nsh and the threads.  Closing the port at 300 bps,
		or RESET, restarts the normal firmware.  UART1 is driven here
		directly, so NuttX's own UART1 driver (RP2040_UART1) must be
		off: it would take the pins at boot.
```
