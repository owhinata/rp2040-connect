## nuttx/apps/sensor/Kconfig
```kconfig
#
# For a description of the syntax of this configuration file,
# see the file kconfig-language.txt in the NuttX tools repository.
#

config NANO_APP_SENSOR
	tristate "sensor command (the Zephyr build's sensor shell)"
	default y
	depends on NANO_SUBCMD && NANO_LSM6DSO_STREAM
	---help---
		"sensor get|attr_set|attr_get|stream|trig": the Zephyr build's
		sensor shell (zephyr/app/usb-console/drivers/sensor_shell/
		sensor_shell.c, Zephyr v4.5.0's drivers/sensor/sensor_shell.c
		with the LSM6DSO's FIFO attributes, and sensor_shell_stream.c)
		with the same syntax and output, on the Zephyr compatibility
		layer and the Zephyr shell's command handling of
		nuttx/apps/subcmd/zshell.c.  Also the thread
		sensor_shell_processing_tid (Zephyr priority 0, NuttX 118,
		CONFIG_SENSOR_SHELL_THREAD_STACK_SIZE 3072), which the init task
		starts at boot and which prints the results of "sensor get" and
		"sensor stream" on the terminal of the session that asked for
		them.  CONFIG_SENSOR_INFO is not set in the Zephyr build, so
		there is no "sensor info".

if NANO_APP_SENSOR

config NANO_APP_SENSOR_PRIORITY
	int "sensor task priority"
	default 104
	---help---
		The shell's priority (NANO_PRIO_SHELL in
		nuttx/drivers/include/priorities.h): the Zephyr build runs shell
		commands in its shell thread.

config NANO_APP_SENSOR_STACKSIZE
	int "sensor stack size"
	default 3072
	---help---
		The Zephyr build runs the command on the shell thread's stack
		(CONFIG_SHELL_STACK_SIZE 3072).

endif
```

## nuttx/apps/wifi/Kconfig
```kconfig
#
# For a description of the syntax of this configuration file,
# see the file kconfig-language.txt in the NuttX tools repository.
#

config NANO_WIFI_CREDENTIALS
	bool "Stored Wi-Fi credentials (wifi_credentials.c)"
	default y
	depends on NANO_NINA_NET && MTD_CONFIG_NVS && MTD_CONFIG_NAMED
	---help---
		The Zephyr build's Wi-Fi credentials library
		(subsys/net/lib/wifi_credentials/ with its settings backend,
		CONFIG_WIFI_CREDENTIALS_BACKEND_SETTINGS) on /dev/config (NuttX's
		NVS, the store of the kv command), under the same names
		("wifi_cred/0" and so on), which the kv command cannot reach
		(its keys are stored as "app_kv/<key>").  Also the request
		NET_REQUEST_WIFI_CONNECT_STORED of the Zephyr compatibility
		layer (CONFIG_WIFI_CREDENTIALS_CONNECT_STORED).  Built into the
		application library; the init task reads the stored SSIDs at
		boot.

if NANO_WIFI_CREDENTIALS

config NANO_WIFI_CREDENTIALS_MAX_ENTRIES
	int "Maximum number of stored networks"
	default 2
	range 1 99
	---help---
		The Zephyr build's CONFIG_WIFI_CREDENTIALS_MAX_ENTRIES.

config NANO_WIFI_CREDENTIALS_SAE_PASSWORD_LENGTH
	int "Room for a password in an entry"
	default 128
	---help---
		The Zephyr build's CONFIG_WIFI_CREDENTIALS_SAE_PASSWORD_LENGTH.
		An entry keeps MAX(64, this) bytes of password.

config NANO_WIFI_CREDENTIALS_CONNECTION_TIMEOUT
	int "Connection timeout of a stored network (s)"
	default 30
	---help---
		The Zephyr build's
		CONFIG_WIFI_CREDENTIALS_CONNECT_STORED_CONNECTION_TIMEOUT: the
		timeout passed with the connection request of a stored network
		that has none of its own.  The NINA driver does not use it (it
		waits 30 s itself).

endif

config NANO_WIFI_PROFILE
	bool "Wi-Fi profile and automatic reconnection (wifi_profile.c)"
	default y
	depends on NANO_WIFI_CREDENTIALS && NANO_KV_STORE
	---help---
		wifi_profile.c: the Zephyr build's src/wifi_profile.c with only
		the system calls replaced: the thread wifi_reconnect_tid (Zephyr
		priority 8, NuttX 110, 2048-byte stack), which the init task
		starts at boot, connects to the stored networks 4 s after a
		request and then every 32 s while there is no address, from
		boot when networks are stored and after a lost connection;
		a disconnection asked for (wapi disconnect) stops it until the
		next successful connection.  Replaces nuttx/drivers/nina/
		wifi_profile_null.c.

config NANO_APP_WIFI
	tristate "wifi command (wifi cred)"
	default y
	depends on NANO_WIFI_CREDENTIALS && NANO_SUBCMD
	---help---
		"wifi cred add|delete|list|auto_connect": the Zephyr build's
		wifi credentials shell (subsys/net/lib/wifi_credentials/
		wifi_credentials_shell.c) with the same syntax and output.  The
		other subcommands of the Zephyr build's wifi command are NuttX's
		wapi and ifconfig.

if NANO_APP_WIFI

config NANO_APP_WIFI_PRIORITY
	int "wifi task priority"
	default 104
	---help---
		The shell's priority (NANO_PRIO_SHELL in
		nuttx/drivers/include/priorities.h): the Zephyr build runs shell
		commands in its shell thread.

config NANO_APP_WIFI_STACKSIZE
	int "wifi stack size"
	default 3072
	---help---
		The Zephyr build runs the command on the shell thread's stack
		(CONFIG_SHELL_STACK_SIZE 3072).  The NVS write, with garbage
		collection, runs on this stack too.

endif
```

## nuttx/boards/arduino-nano-rp2040-connect/Kconfig
```kconfig
#
# For a description of the syntax of this configuration file,
# see the file kconfig-language.txt in the NuttX tools repository.
#
# Board-specific options of arduino-nano-rp2040-connect.  NuttX sources
# this file inside "if ARCH_BOARD_CUSTOM" through a copy,
# nuttx/nuttx/boards/dummy/Kconfig, made once at configure time;
# nuttx/script/build.sh configures again when this file changes.
#

config NANO_TICKLESS
	bool "System timer on the RP2040 TIMER (ALARM0)"
	default y
	depends on ARCH_CHIP_RP2040 && !SMP
	select ONESHOT
	select ONESHOT_COUNT
	select ALARM_ARCH
	---help---
		Drive the OS clock from ALARM0 of the RP2040 TIMER (64-bit, 1 MHz,
		from the crystal) through the oneshot/alarm interface
		(src/nano_oneshot.c, src/nano_timerisr.c and
		drivers/timers/arch_alarm.c) instead of the periodic SysTick of
		arch/arm/src/rp2040/rp2040_timerisr.c.  ALARM_ARCH selects
		ARCH_HAVE_TICKLESS, so SCHED_TICKLESS can be set (the imu
		defconfig sets it, with USEC_PER_TICK 100: the 100 us tickless
		kernel of the Zephyr build).  rp2040_timerisr.c is left out of the
		build by nuttx/patches/nuttx/0004 when ALARM_ARCH is set.
		ONESHOT_COUNT has no prompt and can only be selected.
		src/nano_oneshot.c also replaces the weak up_timer_gettick(),
		up_timer_gettime(), up_alarm_tick_start(), up_alarm_cancel(),
		up_udelay() and up_ndelay() of arch_alarm.c with versions that
		read the TIMER directly and convert with src/nano_timeconv.h
		(1 MHz counts, 100 us ticks, no 64-bit division), so it needs
		USEC_PER_TICK to be 100.  ONESHOT_FAST_DIVISION is not selected:
		it only changes the generic conversions, which these replace.

config NANO_PERF
	bool "Perf counter on the RP2040 TIMER (up_perf_*)"
	default y
	depends on ARCH_CHIP_RP2040
	select ARCH_HAVE_PERF_EVENTS
	---help---
		src/nano_perf.c: up_perf_gettime() returns the TIMER count
		(nano_mono_us(), 1 MHz, 64 bits) and up_perf_getfreq() 1000000.
		The Cortex-M0+ has no cycle counter.  Used by the critical
		section monitor (SCHED_CRITMONITOR, SCHED_CPULOAD_CRITMONITOR) to
		account each task's CPU time at every context switch: the CPU
		column of ps, /proc/cpuload, /proc/<pid>/loadavg and the total
		run time in /proc/<pid>/critmon.  Without it,
		drivers/timers/arch_alarm.c supplies a slower counter in
		nanoseconds through the oneshot.

config NANO_STACK_SENTINEL
	bool "Stack sentinel (check the lowest stack word)"
	default y
	depends on STACK_COLORATION && !SMP && ARCH_ARMV6M
	select SCHED_INSTRUMENTATION
	select SCHED_INSTRUMENTATION_SWITCH
	select SCHED_INSTRUMENTATION_IRQHANDLER
	---help---
		Check that the lowest word of a task's stack still holds the
		coloration value when the task is switched out and at the end of
		every interrupt handler (for the interrupted task, whose stack
		holds the frame the hardware saved, and with ARCH_INTERRUPTSTACK=0
		the handler's own use too), and halt (PANIC) if not: the counterpart of
		the Zephyr build's CONFIG_STACK_SENTINEL (src/nano_stackcheck.c).
		Implemented in the scheduler's instrumentation hooks
		sched_note_suspend() and sched_note_irqhandler(), which need
		SCHED_INSTRUMENTATION, SCHED_INSTRUMENTATION_SWITCH and
		SCHED_INSTRUMENTATION_IRQHANDLER but no note driver.

config NANO_FLASH_KV
	bool "Key-value store in the last 8 KiB of the flash (/dev/config)"
	default y
	depends on ARCH_CHIP_RP2040 && !SMP
	depends on MTD_CONFIG_NVS && MTD_CONFIG_NAMED
	depends on MTD_CONFIG_BLOCKSIZE_MULTIPLE = 1
	---help---
		src/nano_flash_kv.c: an MTD over flash offsets 0xffe000-0xffffff
		(BOARD_KV_OFFSET, BOARD_KV_SIZE in include/board.h; __kv_start,
		__kv_end in scripts/nano-flash.ld), two 4 KiB erase sectors, the
		place of the Zephyr build's storage_partition, registered as
		/dev/config through NuttX's NVS (mtd_config_nvs.c).  Every erase
		and program is checked to lie inside that area.  The MTD reports
		a 1-byte program unit so that NVS packs its entries; it programs
		whole 256-byte pages with 0xff around the data.  At boot, an area
		that holds neither NuttX's NVS layout nor only erased bytes (for
		example the Zephyr build's NVS) is erased before it is mounted.
		The store's format is not the Zephyr build's.

config NANO_I2C0
	bool "I2C0 controller (LSM6DSOX, ATECC608A)"
	default y
	depends on ARCH_CHIP_RP2040 && I2C && !RP2040_I2C
	---help---
		src/nano_i2c.c: I2C0 on GPIO12 (SDA) and GPIO13 (SCL), a port of
		the controller path of the Zephyr build's DesignWare driver
		(zephyr/app/usb-console/drivers/i2c_dw/i2c_dw.c): interrupt
		driven, RX in batches of 4, 1 s transfer timeout with an abort,
		the Zephyr SCL counts (100 kHz, 400 kHz, 1 MHz).  It replaces
		NuttX's arch/arm/src/rp2040/rp2040_i2c.c, which must stay off
		(RP2040_I2C), and sets up the pins itself.  Registered as
		/dev/i2c0 when I2C_DRIVER is set (the i2c tool uses it).

config NANO_I2C0_DMA
	bool "DMA reads on I2C0"
	default y
	depends on NANO_I2C0 && !RP2040_DMAC
	---help---
		The Zephyr build's CONFIG_I2C_DW_RP2040_DMA (on there): a read
		of 32 to 3584 bytes that is the last message of a transfer (so
		it ends with STOP) runs on two DMA channels, one writing the
		command words to IC_DATA_CMD and one reading the data; other
		transfers, and reads when no DMA channel can be had, run on the
		interrupts.  The "i2c_dma" command (nuttx/apps/i2c_dma) switches
		it and shows its counters.  src/nano_dma.c drives the DMA as the
		Zephyr build's dma_rpi_pico.c does (channel 0 on DMA_IRQ_0, the
		others on DMA_IRQ_1, a channel request that never waits, a stop
		that does not wait), so NuttX's own DMA layer
		(arch/arm/src/rp2040/rp2040_dmac.c) must be off: RP2040_DMAC
		takes DMA_IRQ_0 for every channel.  Nothing else in this port
		uses the DMA.
```

## nuttx/drivers/lsm6dso/Kconfig
```kconfig
#
# For a description of the syntax of this configuration file,
# see the file kconfig-language.txt in the NuttX tools repository.
#

config NANO_LSM6DSO
	bool "LSM6DSOX IMU driver (Zephyr build's LSM6DSO driver)"
	default y
	depends on NANO_I2C0
	---help---
		lsm6dso/lsm6dso.c: the Zephyr build's drivers/lsm6dso/lsm6dso.c
		(Zephyr's LSM6DSO driver with the FIFO, calibration and
		zero-rate changes) with only the calls into the system replaced,
		on ST's lsm6dso_reg.c (nuttx/stmemsc, fetched by
		script/setup.sh) and the port's small Zephyr compatibility
		layer (compat/: struct device, the sensor API, the I2C calls).
		The board initializes the device in its bring-up, after I2C0
		and before the key-value store, as the Zephyr build does before
		main() (src/nano_lsm6dso.c).  The FIFO stream (INT1, RTIO) is
		NANO_LSM6DSO_STREAM.

config NANO_LSM6DSO_STREAM
	bool
	default y
	depends on NANO_LSM6DSO
	---help---
		The FIFO stream of the LSM6DSO driver: the Zephyr build's
		CONFIG_SENSOR_ASYNC_API part of drivers/lsm6dso (lsm6dso_stream.c,
		lsm6dso_fifo_irq.c, lsm6dso_compat.c, lsm6dso_fifo_decoder.c),
		on the compatibility layer's RTIO, work queues and gpio0
		(compat/).  Always on with NANO_LSM6DSO: as in Zephyr, lsm6dso.c
		does not build without it.  The board starts the layer's
		threads (zephyr_compat_initialize()) before the LSM6DSOX and
		builds src/nano_gpio.c for the INT1 interrupt.
```

## nuttx/drivers/nina/Kconfig
```kconfig
#
# For a description of the syntax of this configuration file,
# see the file kconfig-language.txt in the NuttX tools repository.
#

config NANO_NINA
	bool "NINA-W102 SPI link (nina_request())"
	default y
	depends on RP2040_SPI1 && !RP2040_SPI_DMA
	---help---
		nina/nina_spi.c: nina_request() and nina_ip_config() of the
		Zephyr build's drivers/nina/nina_wifi.c (the WiFiNINA SPI
		protocol of the module's Arduino firmware), with the same
		framing, timeouts, error values and lazy initialization (the
		module is reset on the first request).  The board provides SPI1
		and the module's lines (src/nano_nina.c).  SPI1 is polled, as in
		the Zephyr build (CONFIG_SPI_PL022_INTERRUPT and _DMA off), so
		RP2040_SPI_DMA must be off.

if NANO_NINA

config NANO_NINA_SPI_FREQUENCY
	int "NINA SPI frequency in Hz"
	default 8000000
	range 1000000 10000000
	---help---
		The requested SPI clock.  The Zephyr build's
		CONFIG_NINA_SPI_FREQUENCY (default 8000000).  The PL022 divides
		clk_peri (125 MHz) by an even number: 8 MHz gives 7.8125 MHz in
		both builds.

config NANO_NINA_USRSOCK
	bool "NINA sockets (usrsock)"
	default y
	depends on NET_USRSOCK_CUSTOM
	---help---
		nina/nina_sock.c, nina_usrsock.c, nina_poller.c: the socket
		offload of the Zephyr build's drivers/nina/nina_socket.c as
		NuttX's usrsock (usrsock_request() in the kernel, handled in the
		calling thread), with the same socket table (10 sockets),
		commands, timeouts and errno names.  The thread "nina_event"
		polls the module's sockets and turns their state into usrsock
		events, as the Zephyr build's connect() and poll() poll in
		their callers.

config NANO_NINA_TCP_MAX_IO
	int "Maximum bytes per NINA TCP send"
	default 3584
	range 1 3584
	depends on NANO_NINA_USRSOCK
	---help---
		The Zephyr build's CONFIG_NINA_TCP_MAX_IO.  Bounds each TCP send
		to leave room for framing in the NINA SPI command buffer.  A RAW
		batch of up to 2448 bytes plus its MQTT header is sent in one
		command with the default.

endif # NANO_NINA
```
