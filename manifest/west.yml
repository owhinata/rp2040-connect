## manifest/west.yml
```yaml
manifest:
  projects:
    - name: zephyr
      url: https://github.com/zephyrproject-rtos/zephyr
      revision: v4.5.0
      import:
        name-allowlist:
          - cmsis
          - cmsis_6
          - hal_rpi_pico
```

## nuttx/apps/bootsel/Kconfig
```kconfig
#
# For a description of the syntax of this configuration file,
# see the file kconfig-language.txt in the NuttX tools repository.
#

config NANO_APP_BOOTSEL
	tristate "bootsel command (development)"
	default y
	depends on ARCH_BOARD_CUSTOM && ARCH_CHIP_RP2040
	---help---
		A development command: "bootsel" (no arguments) prints a message,
		waits until the output has gone out, and reboots into the RP2040
		USB bootloader (BOOTSEL: the RPI-RP2 drive) through the boot ROM's
		reset_usb_boot(0, 0) (nano_reset_usb_boot() in the board code).
		nuttx/script/flash.sh uses it to write a new UF2 without pressing
		the RESET button.  With any argument it only prints its usage and
		does nothing else, so "bootsel --help" does not reboot.  Turn it
		off for a build that should not be put into the bootloader from
		the shell.

if NANO_APP_BOOTSEL

config NANO_APP_BOOTSEL_PRIORITY
	int "bootsel task priority"
	default 100

config NANO_APP_BOOTSEL_STACKSIZE
	int "bootsel stack size"
	default DEFAULT_TASK_STACKSIZE

endif
```

## nuttx/apps/dmesg/Kconfig
```kconfig
#
# For a description of the syntax of this configuration file,
# see the file kconfig-language.txt in the NuttX tools repository.
#

config NANO_APP_DMESG
	tristate "dmesg command (RAM log)"
	default y
	depends on NANO_LOG_RAM
	---help---
		"dmesg" prints the RAM log (nuttx/drivers/log/log_ram.c) the way
		the Zephyr build's dmesg command does: the stored text as is, or
		"No logs." when it is empty.  Arguments are ignored.  NuttX's own
		nsh dmesg (NSH_DISABLE_DMESG) reads /dev/kmsg and is not used.

if NANO_APP_DMESG

config NANO_APP_DMESG_PRIORITY
	int "dmesg task priority"
	default 104
	---help---
		The Zephyr build runs shell commands in the shell thread, at
		K_LOWEST_APPLICATION_THREAD_PRIO (14), which is 104 here
		(nuttx/drivers/include/priorities.h, NANO_PRIO_SHELL).

config NANO_APP_DMESG_STACKSIZE
	int "dmesg stack size"
	default 3072
	---help---
		CONFIG_SHELL_STACK_SIZE of the Zephyr build, which runs shell
		commands in the shell thread.  The output goes through the
		caller's stack down to the NINA's SPI transfer when the command
		runs in a Telnet session (nuttx/apps/init/nano_telnet.c); 1024
		overflowed there.

endif
```

## nuttx/apps/i2c_dma/Kconfig
```kconfig
#
# For a description of the syntax of this configuration file,
# see the file kconfig-language.txt in the NuttX tools repository.
#

config NANO_APP_I2C_DMA
	tristate "i2c_dma command (I2C0 DMA reads)"
	default y
	depends on NANO_I2C0_DMA && NANO_SUBCMD
	---help---
		"i2c_dma mode [on|off]" and "i2c_dma stats": the Zephyr build's
		i2c_dma command (drivers/i2c_dw/i2c_dw.c) with the same syntax
		and output, on the board's I2C driver (NANO_I2C0_DMA).

if NANO_APP_I2C_DMA

config NANO_APP_I2C_DMA_PRIORITY
	int "i2c_dma task priority"
	default 104
	---help---
		The shell's priority (NANO_PRIO_SHELL in
		nuttx/drivers/include/priorities.h): the Zephyr build runs shell
		commands in its shell thread.

config NANO_APP_I2C_DMA_STACKSIZE
	int "i2c_dma stack size"
	default 3072
	---help---
		The Zephyr build runs the command on the shell thread's stack
		(CONFIG_SHELL_STACK_SIZE 3072).

endif
```

## nuttx/apps/imu/Kconfig
```kconfig
#
# For a description of the syntax of this configuration file,
# see the file kconfig-language.txt in the NuttX tools repository.
#

config NANO_KV_STORE
	bool "Key-value store (kv_store.c)"
	default y
	depends on MTD_CONFIG_NVS && MTD_CONFIG_NAMED
	---help---
		kv_store_init/set/get/delete() of the Zephyr build's
		src/kv_store.[ch] on /dev/config (NuttX's NVS on the board's
		key-value area, NANO_FLASH_KV), with the same keys (1-32
		characters: letters, digits, '_', '-', '.'), values (1-128 bytes)
		and error values.  Built into the application library; the "kv"
		command (NANO_APP_KV), the init task and the IMU service
		(NANO_APP_IMU) use it.

config NANO_APP_IMU
	tristate "IMU acquisition service and the imu command"
	default y
	depends on NANO_KV_STORE && NANO_SUBCMD && NANO_LSM6DSO_STREAM
	select LIBC_IPv4_ADDRCONV if !NET_IPv4
	---help---
		imu_stream.c: the Zephyr build's src/imu_stream.c with only the
		system calls replaced (on the Zephyr compatibility layer of
		nuttx/drivers/compat): the thread imu_stream_tid (Zephyr
		priority 9, NuttX 109, 2048-byte stack), which the init task
		starts at boot, and the "imu start|stop|status|cal" command
		with the Zephyr build's syntax and output, and the calibration
		(imu_cal.c, the Zephyr build's src/imu_cal.c: the stored values
		of the key-value store for the LSM6DSO driver, "imu cal"); the
		MQTT transport is NANO_IMU_RAW_MQTT (imu_raw_mqtt_null.c
		without it: no network) and the time synchronization
		NANO_TIME_SYNC (time_sync_null.c without it: no server time).
		inet_pton() and inet_ntop() for imu.host need
		LIBC_IPv4_ADDRCONV while the network is off.

if NANO_APP_IMU

config NANO_APP_IMU_PRIORITY
	int "imu task priority"
	default 104
	---help---
		The shell's priority (NANO_PRIO_SHELL in
		nuttx/drivers/include/priorities.h): the Zephyr build runs shell
		commands in its shell thread.  The acquisition itself runs in
		imu_stream_tid (109).

config NANO_APP_IMU_STACKSIZE
	int "imu task stack size"
	default 3072
	---help---
		The Zephyr build runs the command on the shell thread's stack
		(CONFIG_SHELL_STACK_SIZE 3072).  "imu start" writes the session
		counter to the key-value store, with garbage collection, on
		this stack.

endif

config NANO_IMU_RAW_MQTT
	bool "MQTT transport of the IMU service (imu_raw_mqtt.c)"
	default y
	depends on NANO_APP_IMU && NANO_NINA_NET && NET_USRSOCK_TCP
	---help---
		imu_raw_mqtt.c: the Zephyr build's src/imu_raw_mqtt.c with only
		the system calls replaced: the thread imu_raw_mqtt_tid (Zephyr
		priority 11, NuttX 107, 2048-byte stack), which the init task
		starts at boot, connects to the MQTT receiver (imu.host and
		imu.port, by default the default gateway's port 1883) while a
		measurement runs, publishes the batches of the send queue
		(imu_raw_queue.c), the status and the info (imu_raw_status.c),
		and reconnects every second after a failure.  The MQTT client is
		the port's copy of the part of Zephyr's MQTT library it uses
		(mqtt_min.c, MQTT 3.1.1 over TCP).  Without this option
		imu_raw_mqtt_null.c stands in: every batch is dropped as while
		disconnected.

config NANO_TIME_SYNC
	bool "Time synchronization with an NTP server (time_sync.c)"
	default y
	depends on NANO_APP_IMU && NANO_NINA_NET && NANO_NINA_DNS && NET_USRSOCK_UDP
	---help---
		time_sync.c: the Zephyr build's src/time_sync.c with only the
		system calls replaced: the thread time_sync_tid (Zephyr
		priority 9, NuttX 109, 2048-byte stack), which the init task
		starts at boot, asks the NTP server (the default gateway, or
		NANO_NINA_NTP_SERVER) every NANO_NINA_NTP_INTERVAL_MS while
		Wi-Fi is connected and keeps the estimate of its time
		(time_offset.c) that the IMU service puts on its batches
		(time_sync_unix_us()), and moves the realtime clock forward to
		it.  The "ntp status" command is NANO_APP_NTP.  Without this
		option time_sync_null.c stands in: no server time.

if NANO_TIME_SYNC

config NANO_NINA_NTP_SERVER
	string "NTP server hostname or IPv4 address"
	default ""
	---help---
		The Zephyr build's CONFIG_NINA_NTP_SERVER.  Empty uses the
		default gateway, normally the PC that provides the Wi-Fi
		network and runs an NTP server for the board.

config NANO_NINA_NTP_PORT
	int "NTP server UDP port"
	default 123
	range 1 65535
	---help---
		The Zephyr build's CONFIG_NINA_NTP_PORT.

config NANO_NINA_NTP_INTERVAL_MS
	int "Interval between NTP queries in milliseconds"
	default 2000
	range 250 3600000
	---help---
		The Zephyr build's CONFIG_NINA_NTP_INTERVAL_MS.  Queries go to a
		server on the local network.  Do not point short intervals at
		public servers.

endif
```

## nuttx/apps/init/Kconfig
```kconfig
#
# For a description of the syntax of this configuration file,
# see the file kconfig-language.txt in the NuttX tools repository.
#

config NANO_APP_INIT
	bool "Init task: nsh on the USB CDC ACM console"
	default n
	depends on NSH_LIBRARY && NSH_CONSOLE && CDCACM && !CDCACM_CONSOLE && !NSH_USBCONSOLE
	depends on SCHED_WAITPID
	---help---
		The first task (CONFIG_INIT_ENTRYPOINT="nano_init_main").  It is
		linked into libapps as a plain function, not as a builtin, so it
		cannot be started from the shell.  It calls nsh_initialize() once,
		then repeatedly opens the USB console (NANO_INIT_CONSOLE), sets the
		terminal modes, makes it fd 0/1/2 and runs an nsh session on it in
		its own task until the session ends (USB disconnected), then opens
		the console again.  NuttX's own USB console front end
		(NSH_USBCONSOLE, CDCACM_CONSOLE) waits for three Enter keys before
		the first prompt and is not used.

if NANO_APP_INIT

config NANO_INIT_CONSOLE
	string "Console device"
	default "/dev/ttyACM0"
	---help---
		The CDC ACM device registered by the board (cdcacm_initialize(0)
		in nano_bringup.c).

config NANO_INIT_RETRY_MS
	int "Retry interval (ms)"
	default 100
	---help---
		How long to wait before trying again while the console cannot be
		opened (USB not configured: -ENOTCONN) or is disconnected, and
		after a session has ended.  Keeps a USB cable that is unplugged or
		a host that suspends the device from turning into a busy loop.

config NANO_INIT_NSH_PRIORITY
	int "nsh task priority"
	default 104
	---help---
		Priority of the nsh session task.  The Zephyr build runs its shell
		thread at the lowest application priority,
		K_LOWEST_APPLICATION_THREAD_PRIO (14), which is 104 here
		(NANO_PRIO_SHELL in nuttx/drivers/include/priorities.h): below
		every other thread of the port.

config NANO_INIT_NSH_STACKSIZE
	int "nsh task stack size"
	default 3072
	---help---
		Stack of the nsh session task: nsh's own commands (ps, free, ...)
		run on it.  Builtin applications run as separate tasks with their
		own stacks.  3072 is CONFIG_SHELL_STACK_SIZE of the Zephyr build.

config NANO_INIT_TELNET
	bool "Telnet shell"
	default y
	depends on NETDEV_TELNET && NET_IPv4
	---help---
		nsh on TCP port NANO_INIT_TELNET_PORT for one client at a time,
		the Zephyr build's Telnet shell backend
		(CONFIG_SHELL_BACKEND_TELNET).  init opens the listening socket
		before the "USB console started" log line, as Zephyr does in a
		SYS_INIT before main(), and a task ("telnetd") accepts the
		clients; a second client is closed at once with "Telnet client
		already connected." in the log.  The sessions run on NuttX's
		Telnet driver (NETDEV_TELNET, TELNET_MAXLCLIENTS=1) with the same
		priority and stack as the USB session.  See nano_telnet.c.

config NANO_INIT_TELNET_PORT
	int "Telnet port"
	default 23
	depends on NANO_INIT_TELNET
	---help---
		CONFIG_SHELL_TELNET_PORT of the Zephyr build.

endif
```

## nuttx/apps/irqstack/Kconfig
```kconfig
#
# For a description of the syntax of this configuration file,
# see the file kconfig-language.txt in the NuttX tools repository.
#

config NANO_APP_IRQSTACK
	tristate "irqstack command (interrupt stack use)"
	default y
	depends on STACK_COLORATION && ARCH_INTERRUPTSTACK > 3
	---help---
		"irqstack" prints how much of the interrupt stack
		(CONFIG_ARCH_INTERRUPTSTACK, the Zephyr build's
		CONFIG_ISR_STACK_SIZE) has been used since boot, in the format of
		the "IRQ 00" line of the Zephyr build's "kernel thread stacks".
		NuttX's ps does not show the interrupt stack.  It reads the stack
		coloration with up_check_intstack() (a flat build lets an
		application call it).  Arguments are ignored.

if NANO_APP_IRQSTACK

config NANO_APP_IRQSTACK_PRIORITY
	int "irqstack task priority"
	default 104
	---help---
		The shell's priority (NANO_PRIO_SHELL in
		nuttx/drivers/include/priorities.h): the Zephyr build runs shell
		commands in its shell thread.

config NANO_APP_IRQSTACK_STACKSIZE
	int "irqstack stack size"
	default 1024

endif
```

## nuttx/apps/kv/Kconfig
```kconfig
#
# For a description of the syntax of this configuration file,
# see the file kconfig-language.txt in the NuttX tools repository.
#

config NANO_APP_KV
	tristate "kv command (key-value store)"
	default y
	depends on NANO_KV_STORE
	---help---
		"kv set|sethex|get|delete": the Zephyr build's kv command
		(src/kv_store.c) with the same syntax and messages, on the
		key-value store of nuttx/apps/imu (NANO_KV_STORE).

if NANO_APP_KV

config NANO_APP_KV_PRIORITY
	int "kv task priority"
	default 104
	---help---
		The shell's priority (NANO_PRIO_SHELL in
		nuttx/drivers/include/priorities.h): the Zephyr build runs shell
		commands in its shell thread.

config NANO_APP_KV_STACKSIZE
	int "kv stack size"
	default 3072
	---help---
		The Zephyr build runs the command on the shell thread's stack
		(CONFIG_SHELL_STACK_SIZE 3072).  The NVS write, with garbage
		collection, runs on this stack too.

endif
```

## nuttx/apps/nina/Kconfig
```kconfig
#
# For a description of the syntax of this configuration file,
# see the file kconfig-language.txt in the NuttX tools repository.
#

config NANO_APP_NINA
	tristate "nina command (NINA-W102 module)"
	default y
	depends on NANO_NINA && NANO_SUBCMD
	---help---
		"nina version": the Zephyr build's nina command
		(src/main.c, cmd_nina_version()) with the same output, on
		nina_request() of nuttx/drivers/nina (NANO_NINA).

if NANO_APP_NINA

config NANO_APP_NINA_PRIORITY
	int "nina task priority"
	default 104
	---help---
		The shell's priority (NANO_PRIO_SHELL in
		nuttx/drivers/include/priorities.h): the Zephyr build runs shell
		commands in its shell thread, and nina_request() runs the SPI
		transfer at the caller's priority.

config NANO_APP_NINA_STACKSIZE
	int "nina stack size"
	default 3072
	---help---
		The Zephyr build runs the command on the shell thread's stack
		(CONFIG_SHELL_STACK_SIZE 3072).

endif
```

## nuttx/apps/ntp/Kconfig
```kconfig
#
# For a description of the syntax of this configuration file,
# see the file kconfig-language.txt in the NuttX tools repository.
#

config NANO_APP_NTP
	tristate "ntp command (ntp status)"
	default y
	depends on NANO_TIME_SYNC && NANO_SUBCMD
	---help---
		"ntp status": the Zephyr build's ntp command (src/time_sync.c
		cmd_ntp_status()) with the same syntax and output.  The handler
		and its command set stay in nuttx/apps/imu/time_sync.c, as in
		the Zephyr build; this is the builtin command that runs them.

if NANO_APP_NTP

config NANO_APP_NTP_PRIORITY
	int "ntp task priority"
	default 104
	---help---
		The shell's priority (NANO_PRIO_SHELL in
		nuttx/drivers/include/priorities.h): the Zephyr build runs shell
		commands in its shell thread.

config NANO_APP_NTP_STACKSIZE
	int "ntp stack size"
	default 3072
	---help---
		The Zephyr build runs the command on the shell thread's stack
		(CONFIG_SHELL_STACK_SIZE 3072).  Over Telnet the output goes to
		the NINA on this stack.

endif
```
